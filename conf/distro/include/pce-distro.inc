## wic/directdisk-grub-legacy.wks
```
part /boot  --source bootimg-grub-legacy --label msdos --active --align 1024 --use-uuid --size 32M
part /      --source rootfs --fstype=ext4 --align 1024 --overhead-factor 1.5
bootloader  --ptable msdos --timeout=5 --append="rootfstype=ext4 console=ttyS0,115200 earlyprintk=serial,ttyS0,115200"
```

## wic/trenchboot-xen-image.wks
```
part /boot --source bootimg-partition --ondisk sda --fstype=ext4 --label boot --align 4096 --fixed-size 64M
part /     --source rootfs --ondisk sda --fstype=ext4 --label rootfs  --align 4096 --fixed-size 12G
```
